## bsp/stm32/stm32f407-st-discovery/board/Kconfig
```kconfig
menu "Hardware Drivers Config"

config SOC_STM32F407VG
    bool
    select SOC_SERIES_STM32F4
    default y

menu "Onboard Peripheral Drivers"
	config PHY_USING_LAN8720A
        bool
		
	config BSP_USING_ETH
        bool "Enable Ethernet"
        select PHY_USING_LAN8720A
        default n
		
	menuconfig BSP_USING_GPRS
        bool "Enable GPRS"
        default n
        select RT_USING_GPRS
        if BSP_USING_GPRS
            config BSP_USING_AIR202
                bool "Enable AIR202 For GPRS"
                default n

            config BSP_USING_SIM800C
                bool "Enable SIM800C For GPRS"
                default n
        endif
    
    menuconfig BSP_USING_TFCARD
        bool "Enable TF CARD"
        default n
        select BSP_USING_SPI
        select BSP_USING_SPI2
        select BSP_SPI2_TX_USING_DMA
        select BSP_SPI2_RX_USING_DMA
endmenu

menu "On-chip Peripheral Drivers"

    config BSP_USING_GPIO
        bool "Enable GPIO"
        select RT_USING_PIN
        default y

    menuconfig BSP_USING_UART
        bool "Enable UART"
        default y
        select RT_USING_SERIAL
        if BSP_USING_UART
            config BSP_USING_UART1
                bool "Enable UART1"
                default y

            config BSP_UART1_RX_USING_DMA
                bool "Enable UART1 RX DMA"
                depends on BSP_USING_UART1 && RT_SERIAL_USING_DMA
                default n
			
	    config BSP_USING_UART2
                bool "Enable UART2"
                default n
			
	    config BSP_USING_UART3
                bool "Enable UART3"
                default n
			
	    config BSP_UART3_RX_USING_DMA
                bool "Enable UART3 RX DMA"
                depends on BSP_USING_UART3 && RT_SERIAL_USING_DMA
	       default n
            config BSP_USING_UART4
                bool "Enable UART4"
                default n

            config BSP_USING_UART5
                bool "Enable UART5"
                default n
		
            config BSP_USING_UART6
                bool "Enable UART6"
                default n   	
       endif
   
   menuconfig BSP_USING_CAN
        bool "Enable CAN"
        default n
        select RT_USING_CAN
        if BSP_USING_CAN
            config BSP_USING_CAN1
            bool "Enable CAN1"
            default n
            config BSP_USING_CAN2
            bool "Enable CAN2"
            default n
        endif

    menuconfig BSP_USING_TIM
        bool "Enable timer"
        default n
        select RT_USING_HWTIMER
        if BSP_USING_TIM
        
            config BSP_USING_TIM3
                bool "Enable TIM3"
                default n

            config BSP_USING_TIM13
                bool "Enable TIM13"
                default n

            config BSP_USING_TIM14
                bool "Enable TIM14"
                default n
        endif

   menuconfig BSP_USING_PWM
        bool "Enable pwm"
        default n
        select RT_USING_PWM
        if BSP_USING_PWM
            menuconfig BSP_USING_PWM8
                bool "Enable timer8 output pwm"
                default n
                if BSP_USING_PWM8
                    config BSP_USING_PWM8_CH1
                        bool "Enable PWM8 channel1"
                        default n
                    config BSP_USING_PWM8_CH2
                        bool "Enable PWM8 channel2"
                        default n
                    config BSP_USING_PWM8_CH3
                        bool "Enable PWM8 channel3"
                        default n
  		    config BSP_USING_PWM8_BKIN
                        bool "Enable PWM8 BKIN"
                        default n
                endif
        endif

    menuconfig BSP_USING_SPI
        bool "Enable SPI BUS"
        default n
        select RT_USING_SPI
        if BSP_USING_SPI
            config BSP_USING_SPI1
                bool "Enable SPI1 BUS"
                default n

            config BSP_SPI1_TX_USING_DMA
                bool "Enable SPI1 TX DMA"
                depends on BSP_USING_SPI1
                default n
                
            config BSP_SPI1_RX_USING_DMA
                bool "Enable SPI1 RX DMA"
                depends on BSP_USING_SPI1
                select BSP_SPI1_TX_USING_DMA
                default n
            
            config BSP_USING_SPI2
                bool "Enable SPI2 BUS"
                default n

            config BSP_SPI2_TX_USING_DMA
                bool "Enable SPI2 TX DMA"
                depends on BSP_USING_SPI2
                default n
                
            config BSP_SPI2_RX_USING_DMA
                bool "Enable SPI2 RX DMA"
                depends on BSP_USING_SPI2
                select BSP_SPI2_TX_USING_DMA
		default n
	endif
	
    menuconfig BSP_USING_ADC
        bool "Enable ADC"
        default n
        select RT_USING_ADC
        if BSP_USING_ADC
            config BSP_USING_ADC1
                bool "Enable ADC1"
                default n

            config BSP_USING_ADC2
                bool "Enable ADC2"
                default n

            config BSP_USING_ADC3
                bool "Enable ADC3"
                default n
        endif

    menuconfig BSP_USING_DAC
        bool "Enable DAC"
        default n
        select RT_USING_DAC
        if BSP_USING_DAC
            config BSP_USING_DAC1
                bool "Enable DAC1"
                default n

            config BSP_USING_DAC2
                bool "Enable DAC2"
                default n
        endif		

    menuconfig BSP_USING_I2C1
        bool "Enable I2C1 BUS (software simulation)"
        default n
        select RT_USING_I2C
        select RT_USING_I2C_BITOPS
        select RT_USING_PIN
        if BSP_USING_I2C1
            config BSP_I2C1_SCL_PIN
                int "i2c1 scl pin number"
                range 1 216
                default 24
            config BSP_I2C1_SDA_PIN
                int "I2C1 sda pin number"
                range 1 216
                default 25
        endif
		
 	menuconfig BSP_USING_ONCHIP_RTC
        bool "Enable RTC"
        select RT_USING_RTC
        select RT_USING_LIBC
        default n
        if BSP_USING_ONCHIP_RTC
            choice
                prompt "Select clock source"
                default BSP_RTC_USING_LSE

                config BSP_RTC_USING_LSE
                    bool "RTC USING LSE"

                config BSP_RTC_USING_LSI
                    bool "RTC USING LSI"
            endchoice
        endif	
	menuconfig BSP_USING_USBD_FS
        bool "Enable USB"
        default n
        if BSP_USING_USBD_FS
            config BSP_USING_USBD_FS_DEVICE
                bool "Enable OTGFS as USB device"
				select RT_USING_USB_DEVICE
                default n

            config BSP_USING_USBD_FS_HOST
                bool "Enable OTGFS as USB host"
                select RT_USING_USB_HOST
                default n
        endif

	config BSP_USING_FMC
        bool "Enable FMC"
        default n

    source "../libraries/HAL_Drivers/Kconfig"
    
endmenu

menu "Board extended module Drivers"

endmenu
 
endmenu
```
